## pack-organization/trusted-substrate/config/buildroot/external/Config.in
```kconfig
source "$BR2_EXTERNAL_ELITEEW_TS_PATH/Config.in.board"
source "$BR2_EXTERNAL_ELITEEW_TS_PATH/package/labwc/Config.in"
source "$BR2_EXTERNAL_ELITEEW_TS_PATH/package/gnome-keyring/Config.in"
```

## pack-organization/trusted-substrate/config/buildroot/external/package/gnome-keyring/Config.in
```kconfig
config BR2_PACKAGE_GNOME_KEYRING
	bool "gnome-keyring"
	depends on BR2_USE_WCHAR # libglib2
	depends on BR2_TOOLCHAIN_HAS_THREADS # libglib2
	depends on BR2_USE_MMU # libglib2
	depends on !BR2_STATIC_LIBS # p11-kit / gcr
	depends on BR2_PACKAGE_LIBGPG_ERROR_ARCH_SUPPORTS # libgcrypt
	select BR2_PACKAGE_DBUS
	select BR2_PACKAGE_GCR
	select BR2_PACKAGE_LIBGCRYPT
	select BR2_PACKAGE_LIBGLIB2
	select BR2_PACKAGE_LIBCAP_NG
	select BR2_PACKAGE_P11_KIT
	help
	  GNOME Keyring daemon — org.freedesktop.secrets provider for
	  EliteEW Desktop Client device_request_prepare (Rust keyring
	  sync-secret-service). Built without PAM/systemd for appliance
	  autologin; unlocked via eliteew-ts-secrets-up on the session bus.

	  https://gitlab.gnome.org/GNOME/gnome-keyring

comment "gnome-keyring needs a toolchain w/ wchar, threads, dynamic library"
	depends on BR2_PACKAGE_LIBGPG_ERROR_ARCH_SUPPORTS
	depends on BR2_USE_MMU
	depends on !BR2_USE_WCHAR || !BR2_TOOLCHAIN_HAS_THREADS || \
		BR2_STATIC_LIBS
```

## pack-organization/trusted-substrate/config/buildroot/external/package/labwc/Config.in
```kconfig
config BR2_PACKAGE_LABWC
	bool "labwc"
	depends on BR2_PACKAGE_WLROOTS
	depends on !BR2_STATIC_LIBS
	depends on BR2_TOOLCHAIN_HAS_THREADS
	depends on BR2_USE_MMU
	depends on BR2_INSTALL_LIBSTDCPP # pango
	depends on BR2_TOOLCHAIN_HAS_SYNC_4
	select BR2_PACKAGE_CAIRO
	select BR2_PACKAGE_LIBGLIB2
	select BR2_PACKAGE_LIBINPUT
	select BR2_PACKAGE_LIBPNG
	select BR2_PACKAGE_LIBXML2
	select BR2_PACKAGE_LIBXKBCOMMON
	select BR2_PACKAGE_PANGO
	select BR2_PACKAGE_PIXMAN
	select BR2_PACKAGE_WAYLAND
	select BR2_PACKAGE_WAYLAND_PROTOCOLS
	help
	  labwc — wlroots-based window-stacking Wayland compositor
	  (Openbox-compatible). EliteEW Trusted Substrate kiosk uses it
	  for multi-window Tauri (launcher + product).

	  https://labwc.github.io/

if BR2_PACKAGE_LABWC

config BR2_PACKAGE_LABWC_XWAYLAND
	bool "XWayland support"
	default y
	depends on BR2_PACKAGE_WLROOTS_XWAYLAND
	select BR2_PACKAGE_LIBXCB
	select BR2_PACKAGE_XCB_UTIL_WM
	help
	  Enable XWayland clients under labwc (needs wlroots XWayland).

endif
```
